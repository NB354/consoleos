## buildroot-external/Config.in
```kconfig
source "$BR2_EXTERNAL_CONSOLEOS_PATH/package/consoleos-ui/Config.in"
source "$BR2_EXTERNAL_CONSOLEOS_PATH/package/consoleos-gamemgr/Config.in"
source "$BR2_EXTERNAL_CONSOLEOS_PATH/package/consoleos-sandbox/Config.in"
source "$BR2_EXTERNAL_CONSOLEOS_PATH/package/consoleos-pad/Config.in"
source "$BR2_EXTERNAL_CONSOLEOS_PATH/package/consoleos-update/Config.in"
source "$BR2_EXTERNAL_CONSOLEOS_PATH/package/consoleos-notify/Config.in"
```

## buildroot-external/package/consoleos-gamemgr/Config.in
```kconfig
config BR2_PACKAGE_CONSOLEOS_GAMEMGR
	bool "consoleos-gamemgr"
	select BR2_PACKAGE_SQLITE
	select BR2_PACKAGE_LIBARCHIVE
	select BR2_PACKAGE_OPENSSL
	help
	  Démon gestionnaire de jeux (paquets .zpk) de ConsoleOS.
```

## buildroot-external/package/consoleos-notify/Config.in
```kconfig
config BR2_PACKAGE_CONSOLEOS_NOTIFY
	bool "consoleos-notify"
	help
	  Bus de notifications système de ConsoleOS.
```

## buildroot-external/package/consoleos-pad/Config.in
```kconfig
config BR2_PACKAGE_CONSOLEOS_PAD
	bool "consoleos-pad"
	select BR2_PACKAGE_LIBEVDEV
	help
	  Démon de gestion des manettes de ConsoleOS.
```

## buildroot-external/package/consoleos-sandbox/Config.in
```kconfig
config BR2_PACKAGE_CONSOLEOS_SANDBOX
	bool "consoleos-sandbox"
	help
	  Lanceur bac à sable (namespaces Linux + cgroups v2) pour ConsoleOS.
```

## buildroot-external/package/consoleos-ui/Config.in
```kconfig
config BR2_PACKAGE_CONSOLEOS_UI
	bool "consoleos-ui"
	select BR2_PACKAGE_SDL2
	select BR2_PACKAGE_SDL2_IMAGE
	select BR2_PACKAGE_SDL2_TTF
	select BR2_PACKAGE_SQLITE
	help
	  Compositeur et interface graphique de ConsoleOS.
```

## consoleos/buildroot-external/package/consoleos-update/Config.in
```kconfig
config BR2_PACKAGE_CONSOLEOS_UPDATE
	bool "consoleos-update"
	select BR2_PACKAGE_LIBSODIUM
	help
	  Démon de mise à jour hors-ligne signée de ConsoleOS.
```
